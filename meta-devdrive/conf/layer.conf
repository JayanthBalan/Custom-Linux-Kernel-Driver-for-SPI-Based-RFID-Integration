## meta-devdrive/conf/layer.conf
```bitbake
BBPATH .= ":${LAYERDIR}"

BBFILES += "${LAYERDIR}/recipes-*/*/*.bb ${LAYERDIR}/recipes-*/*/*.bbappend"

BBFILE_COLLECTIONS += "meta-devdrive"
BBFILE_PATTERN_meta-devdrive = "^${LAYERDIR}/"
BBFILE_PRIORITY_meta-devdrive = "6"

LAYERDEPENDS_meta-devdrive = "core"
LAYERSERIES_COMPAT_meta-devdrive = "hardknott kirkstone"
```
